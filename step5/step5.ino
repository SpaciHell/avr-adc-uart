#include <avr/interrupt.h>

volatile char send_ = 1; //флаг нужно отправить или ещё нет

void uart_init() //настройка uart
{
  UBRR0 = 103; //скорость передачи данных 9600 при 16 МГц
  UCSR0B = (1 << TXEN0); //включаем передачу
}
void adc_init() //настройка АЦП
{
  ADCSRA = (1 << ADEN) | (1 << ADPS0) | (1 << ADPS1) | (1 << ADPS2); //включение АЦП, делитель частоты 128
  ADMUX = (1 << REFS0); // внешнее опорное напряжение +5В
}

void setup()
{
  uart_init();
  adc_init();
  //используем таймер1
  TCCR1A = 0;
  TCCR1B = (1 << WGM12) | (1 << CS12); //режим СТС(4 режим) и делитель 256, поэтому предыдущая строчка 0
  OCR1A = 62499; // срабатывает 1 раз в сек
  TIMSK1 = (1 << OCIE1A); //прерывние при достижении значения OCR1A
  sei();
}

ISR(TIMER1_COMPA_vect) { //сообщаем раз в секунду что пора отправить
  send_  = 1;
}

void uart_send_char(char c)//дождаться пока канал пуст и положить букву
{
  while (!(UCSR0A & (1 << UDRE0)));
  UDR0 = c;
}

void uart_send_string(const char *s) //пройти по строке до '\0' и отправить каждую букву через uart_send_char
{
  while (*s != '\0') {
    uart_send_char(*s);
    s++;
  }
}

void uart_send_number(unsigned int n) //вывод числа в терминал
{
  int num = 0; //храним цифру для записи в массив
  int count = 0; //счётчик для записи чисел в массив
  char arr[5];  //чаровский тип используем для хранения символов и вместит он 5 элементов
  if (n == 0) {
    arr[0] = '0'; //символ и цифра разные вещи, поэтому испольуем таблицу аски
    count = 1;
  }
  while (n > 0) {
    num = n % 10; //отделяем последнюю цифру и работаем с ней
    arr[count] = num + '0'; //номер картинки всегда на 48 больше самой цифры,поэтому '0' та же 48
    count++;
    n /= 10; //окончательно удаляем последнюю цифру
  }
  for (int i = count - 1; i >= 0; i--) { //выводим массив с последнего элемента
    uart_send_char(arr[i]);
  }
}

unsigned int adc_read() // одно измерение, возвращает число с АЦП
{
  ADCSRA |=(1 << ADSC); //запустить измерение
  while (ADCSRA & (1 << ADSC)) {} //ждём пока не станет 0(измерение закончено)
  return ADC; //возвращаем значение
}

void loop() {
  if (send_  == 1) { //пришло ли время отпарвки
    send_  = 0; //сбрасываем до следующего раза
    uart_send_string("adc = ");
    uart_send_number(adc_read());
    uart_send_string("\r\n");
  }
}
